/*
 * Copyright (c) 2020 Pete Johanson
 *
 * SPDX-License-Identifier: MIT
 */
 #include "cradio-screen.dtsi"
 
nice_view_spi: &spi0 {
    compatible = "nordic,nrf-spim";
    mosi-pin = <39>;
    sck-pin = <34>;
    miso-pin = <2>;
    cs-gpios = <&gpio1 1 GPIO_ACTIVE_HIGH>;

}; 
