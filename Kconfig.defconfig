## Kconfig.defconfig
```kconfig
if SHIELD_CRADIOS_LEFT

config ZMK_KEYBOARD_NAME
	default "Cradios"

config ZMK_SPLIT_BLE_ROLE_CENTRAL
	default y
endif


if SHIELD_CRADIOS_RIGHT

config ZMK_KEYBOARD_NAME
	default "CRADIOS_Right"

endif

if SHIELD_CRADIOS_RIGHT || SHIELD_CRADIOS_LEFT

config ZMK_SPLIT
	default y

endif
```

## absolem/Kconfig.defconfig
```kconfig
# Copyright (c) 2020 The ZMK Contributors
# SPDX-License-Identifier: MIT

if SHIELD_ABSOLEM

config ZMK_KEYBOARD_NAME
    default "Absolem"

endif
```

## cradio-blue/Kconfig.defconfig
```kconfig
if SHIELD_CRADIO-BLUE_LEFT 

config ZMK_KEYBOARD_NAME
	default "Cradiozlue"

config ZMK_SPLIT_BLE_ROLE_CENTRAL
	default y

endif


if SHIELD_CRADIO-BLUE_RIGHT 
config ZMK_KEYBOARD_NAME
	default "CRADIOb_Right"
endif


if SHIELD_CRADIO-BLUE_RIGHT || SHIELD_CRADIO-BLUE_LEFT

config ZMK_SPLIT
	default y
config ZMK_BATTERY_VOLTAGE_DIVIDER
	default n
config ZMK_BATTERY_NRF_VDDH
	default y
endif
```

## cradio-blue/Kconfig.shield
```kconfig
# Copyright (c) 2020 Pete Johanson
# SPDX-License-Identifier: MIT

config SHIELD_CRADIO-BLUE_LEFT 
	def_bool $(shields_list_contains,cradio-blue_left)

config SHIELD_CRADIO-BLUE_RIGHT 
	def_bool $(shields_list_contains,cradio-blue_right)
```

## cradio-screen/Kconfig.defconfig
```kconfig
if SHIELD_CRADIO-SCREEN_LEFT

config ZMK_KEYBOARD_NAME
	default "Cradio-Screen"

config ZMK_SPLIT_BLE_ROLE_CENTRAL
	default y

config ZMK_DISPLAY
	select LVGL_FONT_MONTSERRAT_24
     
endif	



if SHIELD_CRADIO-SCREEN_RIGHT

config ZMK_KEYBOARD_NAME
	default "cs_Right"

endif


if SHIELD_CRADIO-SCREEN_RIGHT || SHIELD_CRADIO-SCREEN_LEFT

config ZMK_SPLIT
	default y
	

	
	
endif
```

## cradio-screen/Kconfig.shield
```kconfig
# Copyright (c) 2020 Pete Johanson
# SPDX-License-Identifier: MIT

config SHIELD_CRADIO-SCREEN_LEFT
	def_bool $(shields_list_contains,cradio-screen_left)

config SHIELD_CRADIO-SCREEN_RIGHT
	def_bool $(shields_list_contains,cradio-screen_right)
```

## cradio36/Kconfig.defconfig
```kconfig
if SHIELD_CRADIO36_LEFT

config ZMK_KEYBOARD_NAME
	default "Cradio36"

endif


if SHIELD_CRADIO36_RIGHT

config ZMK_KEYBOARD_NAME
	default "Cradio36-Right"

endif


config ZMK_KSCAN_DIRECT_POLLING
	default y
```

## cradio36/Kconfig.shield
```kconfig
# Copyright (c) 2020 Pete Johanson
# SPDX-License-Identifier: MIT

config SHIELD_CRADIO36_LEFT
	def_bool $(shields_list_contains,cradio36_left)

config SHIELD_CRADIO36_RIGHT
	def_bool $(shields_list_contains,cradio36_right)
```

## cradios/Kconfig.defconfig
```kconfig
if SHIELD_CRADIOS_LEFT

config ZMK_KEYBOARD_NAME
	default "Cradio"

endif


if SHIELD_CRADIOS_RIGHT

config ZMK_KEYBOARD_NAME
	default "CRADIOS_Right"

endif


config ZMK_KSCAN_DIRECT_POLLING
	default n
```

## cradios/Kconfig.shield
```kconfig
# Copyright (c) 2020 Pete Johanson
# SPDX-License-Identifier: MIT

config SHIELD_CRADIOS_LEFT
	def_bool $(shields_list_contains,cradios_left)

config SHIELD_CRADIOS_RIGHT
	def_bool $(shields_list_contains,cradios_right)
```

## cradiox/Kconfig.defconfig
```kconfig
if SHIELD_CRADIOX_LEFT

config ZMK_KEYBOARD_NAME
	default "CradioX"

config ZMK_SPLIT_BLE_ROLE_CENTRAL
	default y

endif


if SHIELD_CRADIOX_RIGHT

config ZMK_KEYBOARD_NAME
	default "CRADIOX_Right"

endif


if SHIELD_CRADIOX_RIGHT || SHIELD_CRADIOX_LEFT

config ZMK_SPLIT
	default y


endif
```

## cradiox/Kconfig.shield
```kconfig
# Copyright (c) 2020 Pete Johanson
# SPDX-License-Identifier: MIT

config SHIELD_CRADIOX_LEFT
	def_bool $(shields_list_contains,cradiox_left)

config SHIELD_CRADIOX_RIGHT
	def_bool $(shields_list_contains,cradiox_right)
```

## cradioz/Kconfig.defconfig
```kconfig
if SHIELD_CRADIOZ_LEFT

config ZMK_KEYBOARD_NAME
	default "CradioZ"

config ZMK_SPLIT_BLE_ROLE_CENTRAL
	default y

endif


if SHIELD_CRADIOZ_RIGHT

config ZMK_KEYBOARD_NAME
	default "CRADIOZ_Right"

endif



if SHIELD_CRADIOZ_RIGHT || SHIELD_CRADIOZ_LEFT

config ZMK_SPLIT
	default y

endif
```

## macro2/Kconfig.defconfig
```kconfig
# Copyright (c) 2020 The ZMK Contributors
# SPDX-License-Identifier: MIT

if SHIELD_MACRO2

config ZMK_KEYBOARD_NAME
	default "Macro2"

endif
```

## macro3/Kconfig.defconfig
```kconfig
# Copyright (c) 2020 The ZMK Contributors
# SPDX-License-Identifier: MIT

if SHIELD_MACRO6

config ZMK_KEYBOARD_NAME
	default "Macro6"

endif
```

## macro3/Kconfig.shield
```kconfig
# Copyright (c) 2020 Pete Johanson
# SPDX-License-Identifier: MIT

config SHIELD_MACRO3
	def_bool $(shields_list_contains,macro3)
```

## nazar/Kconfig.defconfig
```kconfig
# Copyright (c) 2022 The ZMK Contributors
# SPDX-License-Identifier: MIT

if SHIELD_NAZAR

config ZMK_KEYBOARD_NAME
    default "Nazar"

endif
```

## parergon/Kconfig.defconfig
```kconfig
if SHIELD_PARERGON_LEFT

config ZMK_KEYBOARD_NAME
	default "Parergon"

config ZMK_SPLIT_BLE_ROLE_CENTRAL
	default y

endif


if SHIELD_PARERGON_RIGHT

config ZMK_KEYBOARD_NAME
	default "Parergon_Right"

endif


if SHIELD_PARERGON_RIGHT || SHIELD_PARERGON_LEFT

config ZMK_SPLIT
	default y


endif
```

## parergon/Kconfig.shield
```kconfig
# Copyright (c) 2020 Pete Johanson
# SPDX-License-Identifier: MIT

config SHIELD_PARERGON_LEFT
	def_bool $(shields_list_contains,parergon_left)

config SHIELD_PARERGON_RIGHT
	def_bool $(shields_list_contains,parergon_right)
```

## saturnine/Kconfig.defconfig
```kconfig
if SHIELD_SATURNINE_LEFT

config ZMK_KEYBOARD_NAME
	default "Saturnine"

config ZMK_SPLIT_BLE_ROLE_CENTRAL
	default y

endif


if SHIELD_SATURNINE_RIGHT

config ZMK_KEYBOARD_NAME
	default "Saturnine_Right"

endif


if SHIELD_SATURNINE_RIGHT || SHIELD_SATURNINE_LEFT

config ZMK_SPLIT
	default y


endif
```

## saturnine/Kconfig.shield
```kconfig
# Copyright (c) 2020 Pete Johanson
# SPDX-License-Identifier: MIT

config SHIELD_SATURNINE_LEFT
	def_bool $(shields_list_contains,saturnine_left)

config SHIELD_SATURNINE_RIGHT
	def_bool $(shields_list_contains,saturnine_right)
```

## sweepv2beta/Kconfig.defconfig
```kconfig
if SHIELD_SWEEPV2_LEFT

config ZMK_KEYBOARD_NAME
	default "Sweepv2"

config ZMK_SPLIT_BLE_ROLE_CENTRAL
	default y

endif


if SHIELD_SWEEPV2_RIGHT

config ZMK_KEYBOARD_NAME
	default "sweepv2_Right"

endif


if SHIELD_SWEEPV2_RIGHT || SHIELD_SWEEPV2_LEFT

config ZMK_SPLIT
	default y


endif
```

## sweepv2beta/Kconfig.shield
```kconfig
# Copyright (c) 2020 Pete Johanson
# SPDX-License-Identifier: MIT

config SHIELD_SWEEPV2_LEFT
	def_bool $(shields_list_contains,sweepv2_left)

config SHIELD_SWEEPV2_RIGHT
	def_bool $(shields_list_contains,sweepv2_right)
```

## zxsp/Kconfig.defconfig
```kconfig
# Copyright (c) 2021 The ZMK Contributors
# SPDX-License-Identifier: MIT

if SHIELD_ZXSP

config ZMK_KEYBOARD_NAME
    default "Zxsp Keyboard"

endif
```
